## techpack/tinno-c330ae/Kconfig
```kconfig
menu "Tinno C330AE project"
	depends on ARCH_SDM439

config MACH_TINNO_C330AE
	bool "Support for Tinno C330AE project"
	help
	  Say Y here to enable support for Tinno C330AE project.

if MACH_TINNO_C330AE

source "techpack/tinno-c330ae/cxd224x/Kconfig"
source "techpack/tinno-c330ae/fastboot_key/Kconfig"
source "techpack/tinno-c330ae/foursemi/Kconfig"
source "techpack/tinno-c330ae/ft8006p/Kconfig"
source "techpack/tinno-c330ae/hall_sensor/Kconfig"

endif # MACH_TINNO_C330AE

endmenu
```

## techpack/tinno-c330ae/fastboot_key/Kconfig
```kconfig
config C330AE_FASTBOOT_KEY
	bool "Reboot into bootloader on FFBM boot or held volume-down"
	depends on INPUT_QPNP_POWER_ON && POWER_RESET_QCOM
	help
	  The Rakuten Mini (Tinno C330AE) bootloader boots FFBM (FastMMI)
	  when volume-down is held at power-on, and it cannot be changed.
	  Say Y to make the kernel turn that boot, or any boot where
	  volume-down is still held when the kernel reaches late init,
	  into a reboot to the bootloader (fastboot). This gives a key
	  path into fastboot that depends only on boot.img.
```
